## main/Kconfig.projbuild
```kconfig
menu "Agent Display"

    config AGENT_WIFI_SSID
        string "WiFi SSID"
        default ""
        help
            默认留空：凭证不入库，首次启动请用 BLE/热点配网。

    config AGENT_WIFI_PASSWORD
        string "WiFi password"
        default ""

    config AGENT_WIFI_STATIC_IP
        bool "Use static IP"
        default n

    config AGENT_WIFI_IP
        string "ESP static IP"
        default ""
        depends on AGENT_WIFI_STATIC_IP

    config AGENT_WIFI_GATEWAY
        string "Gateway / DNS"
        default ""
        depends on AGENT_WIFI_STATIC_IP

    config AGENT_WIFI_NETMASK
        string "Netmask"
        default ""
        depends on AGENT_WIFI_STATIC_IP

    config AGENT_WS_URL
        string "Backend WebSocket URL"
        default ""

    config AGENT_VOICE_HW
        bool "Enable PDM mic + I2S amp"
        default y
        help
            PDM DATA=GPIO16, CLK=GPIO15. Clock starts only in audio_task after app_main.
            Device listens continuously (VAD), no BOOT record button.

    menu "Voice / audio tuning"

        config AGENT_VAD_RMS_START_FLOOR_X1000
            int "VAD start RMS floor (x1000)"
            default 12
        config AGENT_VAD_PEAK_START_FLOOR_X1000
            int "VAD start peak floor (x1000)"
            default 60
        config AGENT_VAD_NOISE_MULT_X10
            int "VAD noise gate multiplier (x10)"
            default 35
        config AGENT_VAD_RMS_HOLD_FLOOR_X1000
            int "VAD hold RMS floor (x1000)"
            default 3
        config AGENT_VAD_NOISE_ALPHA_X100
            int "VAD noise EMA alpha (x100)"
            default 5
        config AGENT_VAD_NOISE_INIT_FRAMES
            int "VAD noise init frames"
            default 24
        config AGENT_VAD_NOISE_RMS_CAP_X1000
            int "VAD noise RMS cap (x1000)"
            default 24
        config AGENT_VAD_NOISE_PEAK_CAP_X1000
            int "VAD noise peak cap (x1000)"
            default 160
        config AGENT_VAD_MIN_MS
            int "VAD min utterance (ms)"
            default 500
        config AGENT_VAD_SILENCE_MS
            int "VAD silence-to-end (ms)"
            default 800
        config AGENT_VAD_MAX_MS
            int "VAD max utterance (ms)"
            default 15000
        config AGENT_VAD_COOLDOWN_MS
            int "VAD cooldown after end (ms)"
            default 800
        config AGENT_PLAY_END_GRACE_MS
            int "Playback end grace (ms)"
            default 800
        config AGENT_PLAY_STALL_MS
            int "Playback stall timeout (ms)"
            default 15000
        config AGENT_UPLOAD_TIMEOUT_MS
            int "Voice upload timeout (ms)"
            default 20000
        config AGENT_PDM_AGC_GAIN_MIN_X10
            int "PDM AGC gain min (x10)"
            default 30
        config AGENT_PDM_AGC_GAIN_MAX_X10
            int "PDM AGC gain max (x10)"
            default 100
        config AGENT_PDM_AGC_GAIN_INIT_X10
            int "PDM AGC gain init (x10)"
            default 50
        config AGENT_PDM_AGC_TARGET_RMS_X1000
            int "PDM AGC target RMS (x1000)"
            default 300
        config AGENT_PDM_AGC_ALPHA_X100
            int "PDM AGC EMA alpha (x100)"
            default 10
        config AGENT_PDM_READ_TIMEOUT_MS
            int "PDM read timeout (ms)"
            default 20

    endmenu

endmenu
```

## sdkconfig.defaults
```kconfig
CONFIG_IDF_TARGET="esp32s3"
CONFIG_ESP_DEFAULT_CPU_FREQ_MHZ_240=y
CONFIG_ESP_DEFAULT_CPU_FREQ_MHZ=240

CONFIG_ESPTOOLPY_FLASHMODE_QIO=y
CONFIG_ESPTOOLPY_FLASHFREQ_80M=y
CONFIG_ESPTOOLPY_FLASHSIZE_16MB=y
CONFIG_ESPTOOLPY_FLASHSIZE="16MB"

CONFIG_PARTITION_TABLE_CUSTOM=y
CONFIG_PARTITION_TABLE_CUSTOM_FILENAME="partitions.csv"
CONFIG_PARTITION_TABLE_FILENAME="partitions.csv"

CONFIG_SPIRAM=y
CONFIG_SPIRAM_MODE_OCT=y
CONFIG_SPIRAM_SPEED_80M=y
CONFIG_SPIRAM_BOOT_INIT=y
CONFIG_SPIRAM_USE_MALLOC=y
CONFIG_SPIRAM_MALLOC_ALWAYSINTERNAL=4096
CONFIG_SPIRAM_MALLOC_RESERVE_INTERNAL=32768

CONFIG_ESP_CONSOLE_USB_SERIAL_JTAG=y
CONFIG_ESP_CONSOLE_SECONDARY_NONE=y

CONFIG_FREERTOS_HZ=1000
CONFIG_ESP_MAIN_TASK_STACK_SIZE=8192
CONFIG_LWIP_TCPIP_TASK_STACK_SIZE=4096
CONFIG_LWIP_MAX_SOCKETS=10

# LVGL 9 (applied after managed component is added)
CONFIG_LV_COLOR_DEPTH_16=y
CONFIG_LV_FONT_MONTSERRAT_14=y
CONFIG_LV_FONT_MONTSERRAT_20=y
CONFIG_LV_USE_GIF=n
CONFIG_LV_USE_LOG=n
CONFIG_LV_DEF_REFR_PERIOD=15
# Load CJK binary font from flash via lv_binfont_create_from_buffer
CONFIG_LV_USE_FS_MEMFS=y
CONFIG_LV_FS_MEMFS_LETTER=77
# binfont copies ~900KB glyphs; LVGL builtin pool is 64KB and panics.
CONFIG_LV_USE_CLIB_MALLOC=y

CONFIG_AGENT_VOICE_HW=y

# BLE provisioning (NimBLE Nordic UART)
CONFIG_BT_ENABLED=y
CONFIG_BT_CTRL_MODE_EFF=1
CONFIG_BT_NIMBLE_ENABLED=y
CONFIG_BT_NIMBLE_ROLE_CENTRAL=n
CONFIG_BT_NIMBLE_ROLE_OBSERVER=n
CONFIG_BT_NIMBLE_ROLE_PERIPHERAL=y
CONFIG_BT_NIMBLE_ROLE_BROADCASTER=y
CONFIG_BT_NIMBLE_MAX_CONNECTIONS=1
CONFIG_ESP_COEX_SW_COEXIST_ENABLE=y
CONFIG_BT_NIMBLE_HOST_TASK_STACK_SIZE=8192

CONFIG_BT_NIMBLE_MEM_ALLOC_MODE_EXTERNAL=y

CONFIG_ESP_WIFI_STATIC_RX_BUFFER_NUM=6
CONFIG_ESP_WIFI_DYNAMIC_RX_BUFFER_NUM=16
CONFIG_ESP_WIFI_DYNAMIC_TX_BUFFER_NUM=16
```
